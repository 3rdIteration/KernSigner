## main/Kconfig.projbuild
```kconfig
menu "KernSigner Configuration"

    choice KSIG_BOARD
        prompt "Target board"
        default KSIG_BOARD_WAVE_4B
        help
            Select the Waveshare ESP32-P4 board variant.

        config KSIG_BOARD_WAVE_4B
            bool "Waveshare ESP32-P4-WiFi6-Touch-LCD-4B (720x720)"

        config KSIG_BOARD_WAVE_35
            bool "Waveshare ESP32-P4-WiFi6-Touch-LCD-3.5 (320x480)"

        config KSIG_BOARD_WAVE_5
            bool "Waveshare ESP32-P4-WiFi6-Touch-LCD-5 (720x1280 MIPI DSI)"

        config KSIG_BOARD_WAVE_43
            bool "Waveshare ESP32-P4-WiFi6-Touch-LCD-4.3 (480x800 MIPI DSI)"
    endchoice

    config KSIG_PRODUCTION_REQUIRE_PIN_HMAC
        bool "Production: require eFuse HMAC key for PIN salt"
        default n
        help
            Development builds may fall back to a deterministic PIN salt so a
            fresh board can be tested before eFuse provisioning. Commercial
            real-funds builds must enable this option so PIN setup/verification
            fails unless eFuse KEY5 is provisioned for the HMAC peripheral.

    config KSIG_PN5180_ENABLED
        bool "Enable PN5180 NFC smartcard reader"
        default y if KSIG_BOARD_WAVE_43
        default n
        help
            Enable the PN5180 SPI NFC reader transport for ISO14443A
            CPU smartcards.

    config KSIG_PN5180_SPI_HZ
        int "PN5180 SPI clock Hz"
        default 1000000
        range 100000 5000000
        depends on KSIG_PN5180_ENABLED
        help
            SPI clock used for the PN5180 NFC module. The tested module is
            reliable at 1 MHz with short jumper wires.

    config KSIG_PN5180_PIN_SCK
        int "PN5180 SCK GPIO"
        default 52 if KSIG_BOARD_WAVE_43
        default -1
        depends on KSIG_PN5180_ENABLED

    config KSIG_PN5180_PIN_MOSI
        int "PN5180 MOSI GPIO"
        default 51 if KSIG_BOARD_WAVE_43
        default -1
        depends on KSIG_PN5180_ENABLED

    config KSIG_PN5180_PIN_MISO
        int "PN5180 MISO GPIO"
        default 50 if KSIG_BOARD_WAVE_43
        default -1
        depends on KSIG_PN5180_ENABLED

    config KSIG_PN5180_PIN_NSS
        int "PN5180 NSS/CS GPIO"
        default 49 if KSIG_BOARD_WAVE_43
        default -1
        depends on KSIG_PN5180_ENABLED

    config KSIG_PN5180_PIN_BUSY
        int "PN5180 BUSY GPIO"
        default 31 if KSIG_BOARD_WAVE_43
        default -1
        depends on KSIG_PN5180_ENABLED

    config KSIG_PN5180_PIN_RST
        int "PN5180 RST GPIO"
        default 30 if KSIG_BOARD_WAVE_43
        default -1
        depends on KSIG_PN5180_ENABLED

    config KSIG_PN5180_PIN_IRQ
        int "PN5180 IRQ GPIO"
        default -1
        depends on KSIG_PN5180_ENABLED
        help
            Optional PN5180 IRQ GPIO. Use -1 when IRQ is not connected.

    config KSIG_SEC1210_ENABLED
        bool "Enable SEC1210 UART smart card reader"
        default n
        help
            Enable the Microchip SEC1210 Smart Card 2 Click driver for
            ISO7816 smart cards over UART using CCID protocol.

            This driver implements the CCID-over-UART protocol used by
            the SEC1210 chip, as documented in the Linux CCID driver's
            ccid_serial.c and MikroElektronika Smart Card 2 Click library.

    config KSIG_SEC1210_UART_NUM
        int "SEC1210 UART peripheral number"
        range 0 3
        default 2
        depends on KSIG_SEC1210_ENABLED
        help
            ESP-IDF UART peripheral to use for SEC1210 communication.

    config KSIG_SEC1210_UART_TX_PIN
        int "SEC1210 UART TX GPIO pin"
        default 17
        depends on KSIG_SEC1210_ENABLED
        help
            GPIO pin connected to the SEC1210 RX line (UART TX from ESP32).

    config KSIG_SEC1210_UART_RX_PIN
        int "SEC1210 UART RX GPIO pin"
        default 16
        depends on KSIG_SEC1210_ENABLED
        help
            GPIO pin connected to the SEC1210 TX line (UART RX to ESP32).

    config KSIG_SEC1210_UART_BAUDRATE
        int "SEC1210 UART baudrate"
        range 9600 460800
        default 115200
        depends on KSIG_SEC1210_ENABLED
        help
            Baud rate for SEC1210 UART communication. Default is 115200
            as used by the Smart Card 2 Click board.

endmenu
```
